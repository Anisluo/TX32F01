#include "HAL_SCU.h"
#include "TX32F01.h"

/********************************************************************************************************
**函数信息 ：SCU_Unlock()
**功能描述 ：使能SCU寄存器写操作
**输入参数 ：无
**输出参数 ：无
********************************************************************************************************/
void SCU_Unlock(void)
{
    SCU->PKR  =0xbadbee;//使能SCU寄存器写操作
}


/********************************************************************************************************
**函数信息 ：SCU_Lock()
**功能描述 ：失能SCU寄存器写操作
**输入参数 ：无
**输出参数 ：无
********************************************************************************************************/
void SCU_Lock(void)
{
    SCU->PKR  =0;//失能SCU寄存器写操作
}


/********************************************************************************************************
**函数信息 ：SCU_SetSysClock(u8 sysclock)
**功能描述 ：设置系统频率
**输入参数 ：sysclock：系统时钟值，可以配置为SysClock_32M~SysClock_125K
**输出参数 ：无
********************************************************************************************************/
void SCU_SetSysClock(u8 sysclock)
{
    SCU->CCR&=~0xf;//清除状态
    SCU->CCR|=sysclock;//设置系统时钟值
}


/********************************************************************************************************
**函数信息 ：SCU_MCO(u32 mcosel,u32 mcopre)
**功能描述 ：设置时钟输出
**输入参数 ：mcosel：时钟源选择，可以配置为MCOSEL_NoOut、MCOSEL_HRC、MCOSEL_LRC，分别是不输出、HRC时钟源、LRC时钟源
						mcopre：时钟输出分频选择，可以配置为MCOPRE_DIV1~MCOPRE_DIV32
**输出参数 ：无
********************************************************************************************************/
void SCU_MCO(u32 mcosel)
{
    SCU->CCR&=~(0x3<<24);//清除状态
    SCU->CCR|=mcosel;//时钟源选择
}


/********************************************************************************************************
**函数信息 ：SCU_PeriphClockCmd(u32 Periph,FunctionalState NewState)
**功能描述 ：打开/关闭外设时钟
**输入参数 ：Periph：需要打开/关闭的外设时钟，可以配置为Periph_TIM0~Periph_ALL
						NewState：ENABLE(开启外设时钟)/DISABLE(关闭外设时钟)
**输出参数 ：无
注意：GPIO0~GPIO3时钟默认打开，不需要配置，即Periph参数不可填入Periph_GPIO0~Periph_GPIO3
********************************************************************************************************/
void SCU_PeriphClockCmd(u32 Periph,FunctionalState NewState)
{
    if (NewState != DISABLE)
    {
        SCU->PENR |= Periph;//打开外设时钟
    }
    else
    {
        SCU->PENR &= ~Periph;//关闭外设时钟
    }
}

/********************************************************************************************************
**函数信息 ：SCU_ResetPeriphClock(u32 Periph)
**功能描述 ：复位外设时钟
**输入参数 ：Periph：需要复位的外设时钟，可以配置为Periph_TIM0~Periph_ALL
**输出参数 ：无
注意：GPIO0~GPIO3可以被复位，即Periph参数可以填入Periph_GPIO0~Periph_GPIO3
********************************************************************************************************/
void SCU_ResetPeriphClock(u32 Periph)
{
    SCU->PRSTR|=Periph;//开启复位
    __NOP();//延时
    __NOP();
    __NOP();
    __NOP();
    __NOP();
    __NOP();
    SCU->PRSTR&=~Periph;//关闭复位
}

/********************************************************************************************************
**函数信息 ：SCU_ClearPWR_Flag(void)
**功能描述 ：清除所有上电复位标志位
**输入参数 ：无
**输出参数 ：无
********************************************************************************************************/
void SCU_ClearPWR_Flag(void)
{
    SCU->RSR|=0x1;//清除所有上电复位标志位
}

/********************************************************************************************************
**函数信息 ：SCU_SetBor(u8 BorLevel,FunctionalState NewState)
**功能描述 ：设置BOR电压阈值,当VDD电压小于设置的BOR阈值电压时，芯片会复位
**输入参数 ：BorLevel：BOR电压阈值选择，可以配置为BOR_2P0V~BOR_4P0V
						NewState：ENABLE(开启BOR)/DISABLE(关闭BOR)
**输出参数 ：无
********************************************************************************************************/
void SCU_SetBor(u8 BorLevel,FunctionalState NewState)
{
    SCU->PMCR&=~0xf;//清除状态

    SCU->PMCR|=BorLevel;//设置BOR电压阈值

    if (NewState != DISABLE)
    {
        SCU->PMCR |= 0x1;//开启BOR
    }
    else
    {
        SCU->PMCR &= ~0x1;//关闭BOR
    }
}


/********************************************************************************************************
**函数信息 ：SCU_SetPVD(u8 PVDLevel,FunctionalState NewState)
**功能描述 ：设置PVD电压阈值,当VDD电压小于设置的PVD阈值电压时，芯片会进入PVD中断
**输入参数 ：PVDLevel：PVD电压阈值选择，可以配置为PVD_2P0V~PVD_4P0V
						NewState：ENABLE(开启PVD)/DISABLE(关闭PVD)
**输出参数 ：无
注意：使用PVD功能需要配置中断PVD_Handler
********************************************************************************************************/
void SCU_SetPVD(u8 PVDLevel,FunctionalState NewState)
{
    u8 i;

    SCU->PMCR&=~(0xf<<4);//清除状态

    SCU->PMCR|=PVDLevel;//设置PVD电压阈值

    if (NewState != DISABLE)
    {
        SCU->PMCR |= 0x1<<4;//开启PVD
    }
    else
    {
        SCU->PMCR &= ~(0x1<<4);//关闭PVD
    }

    for(i=0; i<50; i++); //至少延时10us，等待PVD稳定
}

/********************************************************************************************************
**函数信息 ：GetSystemClock(void)
**功能描述 ：得到当前系统频率
**输入参数 ：无
**输出参数 ：SC：当前系统频率
********************************************************************************************************/
uint32_t 	GetSystemClock(void)
{
    u8 i=SCU->CCR&0xF;//读取当前系统频率
    uint32_t SC=0;

    switch(i)
    {
		case SysClock_12M:
			SC=12*1000000UL;
			break;
		case SysClock_6M:
			SC=6*1000000UL;
			break;
		case SysClock_4M:
			SC=4*1000000UL;
			break;
		case SysClock_2M:
			SC=2*1000000UL;
			break;

		default :
			SC=24*1000000UL;
			break;
    }

    if(i<8)
    {
        SC=24*1000000UL;
    }
    return SC;//返回当前系统频率
}
