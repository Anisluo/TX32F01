#include "HAL_ADC.h"
#include "HAL_SCU.h"
#include "TX32F01.h"

/********************************************************************************************************
**函数信息 ：ADC_DeInit(void)
**功能描述 ：将ADC寄存器恢复默认值
**输入参数 ：无
**输出参数 ：无
********************************************************************************************************/
void ADC_DeInit(void)
{
    SCU_Unlock();// 解锁SCU，可对其余SCU寄存器操作。
    SCU_ResetPeriphClock(Periph_ADC);//复位ADC
    SCU_Lock();//上锁SCU，不可对其余SCU寄存器操作。
}

/********************************************************************************************************
**函数信息 ：ADC_Init(ADC_InitTypeDef *ADC_InitStruct)
**功能描述 ：初始化ADC
**输入参数 ：ADC_InitStruct：ADC初始化参数结构体
**输出参数 ：无
********************************************************************************************************/
void ADC_Init(ADC_InitTypeDef *ADC_InitStruct)
{
    ADC->CR = 0;//清零
    ADC->CFGR=0;//清零
    ADC->SQR1=0;//清零
    ADC->SQR2=0;//清零
	
    //选择ADC参考电压、ADC对齐方式、ADC分频和ADC采样时间
    ADC->CFGR |= ADC_InitStruct->ADC_Vref|ADC_InitStruct->ADC_DataAlign|ADC_InitStruct->ADC_CLK_DIV|ADC_InitStruct->ADC_SAMP_CLK;
   
    ADC->SQR1 |= ADC_InitStruct->ADC_Sequence_Lenth;//选择转换序列长度
}

/********************************************************************************************************
**函数信息 ：ADC_ChannelConfig(uint8_t Rank,uint8_t Channel)
**功能描述 ：配置转换序列号相对应的采样通道
**输入参数 ：Rank：第X个要转换的序列号(范围1~8)
						Channel:序列号对应的通道
**输出参数 ：无
********************************************************************************************************/
void ADC_ChannelConfig(uint8_t Rank,uint8_t Channel)
{
    if(Rank<=6)
    {
        ADC->SQR2 &=~(0x1F<<((Rank-1)*5));//清除状态
        ADC->SQR2 |=Channel<<((Rank-1)*5);//配置序列号及转换的通道
    }
    else if(Rank<=8)
    {
        ADC->SQR1&= ~(Channel<<((Rank-7)*5));//清除状态
        ADC->SQR1|= Channel<<((Rank-7)*5);//配置序列号及转换的通道
    }

}

/********************************************************************************************************
**函数信息 ：ADC_Cmd(FunctionalState NewState)
**功能描述 ：ADC使能
**输入参数 ：NewState：ENABLE(使能ADC)/DISABLE(关闭ADC)
**输出参数 ：无
********************************************************************************************************/
void ADC_Cmd(FunctionalState NewState)
{
    if (NewState != DISABLE)
    {
        ADC->CR = 0x02;//使能ADC
    }
    else
    {
        ADC->CR =  0;//关闭ADC
    }
}

/********************************************************************************************************
**函数信息 ：ADC_StartConversion(void)
**功能描述 ：开始一次采样
**输入参数 ：无
**输出参数 ：无
********************************************************************************************************/
void ADC_StartConversion(void)
{
    ADC->CR |= 1;//开始一次采样
}

/********************************************************************************************************
**函数信息 ：ADC_GetFlagStatus(void)
**功能描述 ：得到标志位状态
**输入参数 ：无
**输出参数 ：无
********************************************************************************************************/
BOOL ADC_GetFlagStatus(void)
{
    if (ADC->IFR)
    {
        return  TRUE;
    }
    else
    {
        return  FALSE;
    }
}


/********************************************************************************************************
**函数信息 ：ADC_ClearFlag(void)
**功能描述 ：清除标志位状态
**输入参数 ：无
**输出参数 ：无
********************************************************************************************************/
void ADC_ClearFlag(void)
{   
    ADC->IFR&=~1;//清除标志位
}

/********************************************************************************************************
**函数信息 ：ADC_ITConfig(FunctionalState NewState)
**功能描述 ：ADC中断使能
**输入参数 ：无
**输出参数 ：无
********************************************************************************************************/
void ADC_ITConfig(FunctionalState NewState)
{
    if (NewState != DISABLE)
    {
        ADC->IER = 1;//开启中断
    }
    else
    {
        ADC->IER =  0;//关闭中断
    }
}

/********************************************************************************************************
**函数信息 ：ADC_GetConversionValue(uint8_t Rank)
**功能描述 ：得到相应通道的ADC采样值
**输入参数 ：Rank：通道序列号（1~8）
**输出参数 ：无
********************************************************************************************************/
uint16_t ADC_GetConversionValue(uint8_t Rank)
{
    return (uint16_t) *((volatile uint32_t *) (ADC_BASE+0x20+((Rank-1)<<2)));//返回ADC采样值
}









