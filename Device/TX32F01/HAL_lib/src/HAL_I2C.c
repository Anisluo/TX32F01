#include "HAL_I2C.h"
#include "HAL_SCU.h"
#include "TX32F01.h"

/********************************************************************************************************
**函数信息 ：I2C_DeInit(void)
**功能描述 ：将I2C寄存器恢复默认值
**输入参数 ：无
**输出参数 ：无
********************************************************************************************************/
void I2C_DeInit(void)
{
	SCU_Unlock();// 解锁SCU，可对其余SCU寄存器操作。
    SCU_ResetPeriphClock(Periph_I2C);//复位I2C
	SCU_Lock();//上锁SCU，不可对其余SCU寄存器操作。
}

/********************************************************************************************************
**函数信息 ：I2C_Master_Init(uint32_t Clk)
**功能描述 ：初始化I2C
**输入参数 ：Clk：I2C时钟，最大600KHz
**输出参数 ：无
********************************************************************************************************/
void I2C_Master_Init(uint32_t Clk)
{
    uint32_t SYSCLK=GetSystemClock();//得到当前系统时钟频率

	I2C->CR = (((SYSCLK+Clk*2)/(Clk<<2)-1)&0xFF)<<8;//配置IIC时钟
}

/********************************************************************************************************
**函数信息 ：I2C_Cmd(FunctionalState NewState)
**功能描述 ：I2C使能
**输入参数 ：NewState：ENABLE(使能UART)/DISABLE(关闭UART)
**输出参数 ：无
********************************************************************************************************/
void I2C_Cmd(FunctionalState NewState)
{
    if (NewState != DISABLE)
    {
        I2C->CR |=(1<<6);//使能UART
    }
    else
    {
        I2C->CR &=~(1<<6);//关闭UART
    }
}

/********************************************************************************************************
**函数信息 ：I2C_ClearSI(void)
**功能描述 ：I2C清除状态标志位，使得状态寄存器进入下一状态
**输入参数 ：无
**输出参数 ：无
********************************************************************************************************/
void I2C_ClearSI(void)
{
	I2C->CR &= ~(1<<3);//写0清此中断标志，同时状态寄存器进入下一状态
}

/********************************************************************************************************
**函数信息 ：I2C_GenerateSTART(void)
**功能描述 ：I2C产生START
**输入参数 ：无
**输出参数 ：无
********************************************************************************************************/
void I2C_GenerateSTART(void)
{
	I2C->CR |= 1<<5;//产生START信号
}

/********************************************************************************************************
**函数信息 ：I2C_GenerateSTOP(void)
**功能描述 ：I2C产生STOP
**输入参数 ：无
**输出参数 ：无
********************************************************************************************************/
void I2C_GenerateSTOP(void)
{
	I2C->CR |= 1<<4;//产生STOP信号
	I2C_ClearSI();//清除SI标志位
}

/********************************************************************************************************
**函数信息 ：I2C_GenerateRESTART(void)
**功能描述 ：I2C产生RESTART
**输入参数 ：无
**输出参数 ：无
********************************************************************************************************/
void I2C_GenerateRESTART(void)
{
	I2C->CR |= 1<<5;//产生RESTART信号
	I2C_ClearSI();//清除SI标志位
}

/********************************************************************************************************
**函数信息 ：I2C_ClearSTART(void)
**功能描述 ：I2C清除START
**输入参数 ：无
**输出参数 ：无
********************************************************************************************************/
void I2C_ClearSTART(void)
{
	I2C->CR &= ~(1<<5);//不产生START信号
}

/********************************************************************************************************
**函数信息 ：I2C_SEND_ACK(void)
**功能描述 ：I2C发送ACK
**输入参数 ：无
**输出参数 ：无
********************************************************************************************************/
void I2C_SEND_ACK(void)
{
	I2C->CR |= (1<<2);//产生ACK信号
	I2C_ClearSI();//清除SI标志位
}

/********************************************************************************************************
**函数信息 ：I2C_SEND_NACK(void)
**功能描述 ：I2C发送NACK
**输入参数 ：无
**输出参数 ：无
********************************************************************************************************/
void I2C_SEND_NACK(void)
{
	I2C->CR &= ~(1<<2);//产生NOACK信号
	I2C_ClearSI();//清除SI标志位
}

/********************************************************************************************************
**函数信息 ：I2C_Sta_Check(u8 Sta)
**功能描述 ：I2C状态标志检查
**输入参数 ：无
**输出参数 ：无
********************************************************************************************************/
booltyped I2C_Sta_Check(u8 Sta)
{
    u32 i=0;
    while (I2C->SR !=Sta)
    {
        i++;
        if(i>2000)
        {
            return falsefp;
        }
    }
    return truefp;//返回状态标志位
}

/********************************************************************************************************
**函数信息 ：I2C_SendData(uint8_t Data)
**功能描述 ：发送数据
**输入参数 ：Data：要发送的数据
**输出参数 ：无
********************************************************************************************************/
void I2C_SendData(uint8_t Data)
{
	I2C->DR = Data&0xff;//发送数据
	I2C_ClearSI();//清除SI标志位
}

/********************************************************************************************************
**函数信息 ：I2C_ReceiveData(void)
**功能描述 ：接收数据
**输入参数 ：无
**输出参数 ：UART接收到的数据
********************************************************************************************************/
uint8_t I2C_ReceiveData(void)
{ 
    return I2C->DR;//接收数据
}



